## config/west.yml
```yaml
manifest:
  remotes:
    - name: zmkfirmware
      url-base: https://github.com/ClicketySplit
  projects:
    - name: zmk
      remote: zmkfirmware
      revision: leeloo_micro_v1_branch
      import: app/west.yml
  self:
    path: config
```
